## config/boards/shields/lumberjack_pro/Kconfig.defconfig
```kconfig
# Copyright (c) 2021 The ZMK Contributors
# SPDX-License-Identifier: MIT

if SHIELD_LUMBERJACK_PRO

config ZMK_KEYBOARD_NAME
    default "lumberjack_pro"

endif
```
